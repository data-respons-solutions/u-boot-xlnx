## configs/ltkn-mlu_defconfig
```kconfig
CONFIG_ARM=y
CONFIG_POSITION_INDEPENDENT=y
CONFIG_ARCH_ZYNQMP=y
CONFIG_TEXT_BASE=0x8000000
CONFIG_SYS_TEXT_BASE=0x8000000
CONFIG_SYS_LOAD_ADDR=0x8000000
CONFIG_SYS_MALLOC_F_LEN=0x8000
CONFIG_SYS_MALLOC_LEN=0x4040000
CONFIG_SPL=n
CONFIG_DEBUG_UART_BASE=0xff000000
CONFIG_DEBUG_UART_CLOCK=100000000
CONFIG_SPL_SPI_FLASH_SUPPORT=y
CONFIG_SPL_SPI_SUPPORT=y
CONFIG_ZYNQMP_USB=y
CONFIG_DEBUG_UART=y
CONFIG_AHCI=y
CONFIG_DISTRO_DEFAULTS=y
CONFIG_REMAKE_ELF=y
CONFIG_FIT=y
CONFIG_FIT_VERBOSE=y
CONFIG_SPL_LOAD_FIT=y
# CONFIG_DISPLAY_CPUINFO is not set
CONFIG_CLOCKS=y
CONFIG_SPL_OS_BOOT=y
CONFIG_SPL_RAM_SUPPORT=y
CONFIG_SPL_RAM_DEVICE=y
CONFIG_SPL_ATF=y
CONFIG_SYS_PROMPT="ZynqMP> "
CONFIG_CMD_THOR_DOWNLOAD=y
CONFIG_CMD_MEMTEST=y
CONFIG_CMD_CLK=y
CONFIG_CMD_DFU=y
CONFIG_CMD_FLASH=y
CONFIG_CMD_FPGA_LOADBP=y
CONFIG_CMD_FPGA_LOADP=y
CONFIG_CMD_FPGA_LOAD_SECURE=y
CONFIG_CMD_FPGA_LOADFS=y
CONFIG_CMD_GPT=y

CONFIG_CMD_MMC=y
CONFIG_CMD_SF=y
CONFIG_CMD_USB=y
CONFIG_CMD_TFTPPUT=y
CONFIG_CMD_TIME=y
CONFIG_CMD_TIMER=y
CONFIG_CMD_EXT4_WRITE=y
CONFIG_SPL_OF_CONTROL=y
CONFIG_DEFAULT_DEVICE_TREE="ftkn-zynqmp-mlu"
# CONFIG_ENV_IS_IN_SPI_FLASH=y
# CONFIG_ENV_OFFSET=0x0F00000
CONFIG_NET_RANDOM_ETHADDR=y
CONFIG_SPL_DM=y
CONFIG_SPL_DM_SEQ_ALIAS=y
CONFIG_SCSI_AHCI=y
CONFIG_SATA_CEVA=y
CONFIG_CLK_ZYNQMP=y
CONFIG_DFU_RAM=y
CONFIG_DFU_SF=y
CONFIG_DFU_SF_PART=y
CONFIG_DFU_MMC=y
CONFIG_DFU_MTD=y
CONFIG_SYS_DFU_DATA_BUF_SIZE=0x1800000
CONFIG_USB_FUNCTION_FASTBOOT=y
CONFIG_FASTBOOT_FLASH=y
CONFIG_FASTBOOT_FLASH_MMC_DEV=0
CONFIG_FASTBOOT_CMD_OEM_FORMAT=y
CONFIG_FPGA_XILINX=y
CONFIG_FPGA_ZYNQMPPL=y
CONFIG_AES=y
# GPIO
CONFIG_CMD_GPIO=y
CONFIG_DM_GPIO=y
CONFIG_XILINX_GPIO=y
# I2C
CONFIG_CMD_I2C=y
CONFIG_DM_I2C=y
CONFIG_SYS_I2C_CADENCE=y
CONFIG_SYS_I2C_XILINX_XIIC=y
# RTC
CONFIG_RTC_PCF8563=y
CONFIG_MISC=y
# CONFIG_ZYNQ_GEM_I2C_MAC_OFFSET is not set
CONFIG_MMC_SDHCI=y
CONFIG_MMC_SDHCI_ZYNQ=y
CONFIG_MMC_HS200_SUPPORT=y
CONFIG_MMC_HS400_SUPPORT=y
CONFIG_MMC_BROKEN_CD=y
CONFIG_DM_SPI_FLASH=y
CONFIG_MTD=y
CONFIG_DM_MTD=y
CONFIG_CMD_MTD=y
CONFIG_CMD_MTDPARTS=y
CONFIG_CMD_MTDPARTS_SHOW_NET_SIZES=y
CONFIG_SPI_FLASH=y
CONFIG_SPI_FLASH_MTD=y
CONFIG_SPI_FLASH_BAR=y
CONFIG_SPI_GENERIC=y
CONFIG_SPI_FLASH_MACRONIX=y
CONFIG_SPI_FLASH_SPANSION=y
# CONFIG_SPI_FLASH_USE_4K_SECTORS is not set
CONFIG_PHY_MARVELL=y
CONFIG_PHY_TI=y
CONFIG_PHY_FIXED=y
CONFIG_PHY_GIGE=y
CONFIG_MII=y
CONFIG_ZYNQ_GEM=y
CONFIG_DM_ETH=y
CONFIG_SCSI=y
CONFIG_DM_SCSI=y
CONFIG_DEBUG_UART_ZYNQ=y
CONFIG_DEBUG_UART_ANNOUNCE=y
CONFIG_ZYNQ_SERIAL=y
CONFIG_SPI=y
CONFIG_ZYNQMP_GQSPI=y
CONFIG_USB=y
CONFIG_USB_XHCI_HCD=y
CONFIG_USB_XHCI_DWC3=y
CONFIG_USB_XHCI_ZYNQMP=y
CONFIG_USB_DWC3=y
CONFIG_USB_DWC3_GADGET=y
CONFIG_USB_DWC3_GENERIC=y
CONFIG_USB_XHCI_DWC3_OF_SIMPLE=y
CONFIG_USB_ULPI_VIEWPORT=y
CONFIG_USB_ULPI=y
CONFIG_USB_GADGET=y
CONFIG_USB_GADGET_MANUFACTURER="Xilinx"
CONFIG_USB_GADGET_VENDOR_NUM=0x03FD
CONFIG_USB_GADGET_PRODUCT_NUM=0x0300
CONFIG_USB_FUNCTION_THOR=y
CONFIG_DM_USB=y
CONFIG_PHY=y
CONFIG_NOP_PHY=y
CONFIG_EFI_LOADER_BOUNCE_BUFFER=y
#CONFIG_PMUFW_INIT_FILE="board/xilinx/zynqmp/ftkn-zynqmp/pmu.bin"
CONFIG_QSPI_MODE_32BIT=y
CONFIG_SPL_SPI_LOAD=y
CONFIG_SYS_CONFIG_NAME="xilinx_zynqmp_ftkn"
CONFIG_BOOTDELAY=4
CONFIG_PARTITIONS=y
CONFIG_PARTITION_TYPE_GUID=y
CONFIG_PARTITION_TYPE_UUID=y
CONFIG_VERSION_VARIABLE=y
CONFIG_ENV_IS_EMBEDDED=y
CONFIG_HUSH_PARSER=y
CONFIG_MTDPARTS_DEFAULT="mtdparts=nor0:16m(boot-pri),16m(boot-sec),1m(env),31m(spare)"
CONFIG_ENV_RAUC=y
CONFIG_ENV_RAUC_CMD=y
CONFIG_ENV_RAUC_MTD_NAME="env"
CONFIG_ENV_RAUC_MAX_SIZE=65536
CONFIG_LOG_ERROR_RETURN=y
CONFIG_IDENT_STRING="ftkn-zynqmp"
CONFIG_SOC_XILINX_ZYNQMP=y
CONFIG_ZYNQMP_POWER_DOMAIN=y
CONFIG_RESET_ZYNQMP=y
CONFIG_POWER_DOMAIN=y
CONFIG_LOG=y
CONFIG_CMD_LOG=y
CONFIG_PHY_XILINX_ZYNQMP=y
CONFIG_XTKN_FIT_CONF="bootconf=conf-ltkn-mlu"
```

## drivers/mtd/env_rauc/Kconfig
```kconfig
config ENV_RAUC_MAX_SIZE
    int "Max capacity"
    default 32768
    help
        Capped below 1/2 MTD capacity

config ENV_RAUC_MTD_NAME
    string "mtd part label"
    default "env"
    help
        The partition

config ENV_RAUC_CMD
    bool "Commands"
    default y
    help
        Enable scripting
```
